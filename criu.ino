#include <TinyWireM.h> // To use the Adafruit's TinyWireM library:
#include <Tiny4kOLED.h> // we are using the Tiny4kOLED library to draw on the display
#include <forcedClimate.h>
#include "5x5_font.h"
const DCfont *currentFont = FONT5X5;
#include "ModernDos8.h"
const DCfont *currentFont1 = FONT8X8MDOS;


#define BUTTON_R_PIN PB4 // pin for UP button 
#define BUTTON_L_PIN PB3 // pin for DOWN button
#define BUTTON_SELECT_PIN PB1

ForcedClimate climateSensor = ForcedClimate();

const unsigned long eventInterval = 1500;
unsigned long previousTime = 0;

// 'Layer 2 (1)', 44x56px
const unsigned char TheKnight[] PROGMEM = {
 0x00, 0x00, 0x00, 0x00, 0x80, 0xc0, 0xe0, 0xf0, 0xf0, 0xf8, 0xfc, 0xfc, 0x3c, 0x0c, 0x00, 0x00,
  0x00, 0x00, 0x00, 0x00, 0x00, 0x00, 0x00, 0x00, 0x00, 0x00, 0x00, 0x00, 0x00, 0x00, 0x0c, 0x3c,
  0xfc, 0xfc, 0xf8, 0xf0, 0xf0, 0xe0, 0xc0, 0x80, 0x00, 0x00, 0x00, 0x00, 0x00, 0xf0, 0xfe, 0xff,
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  0x00, 0x00, 0x00, 0x00
};

bool Mode=1;
int Page=1;

void Sensor() {
  unsigned long currentTime = millis();
  /* This is the event */
  if (currentTime - previousTime >= eventInterval) {
    climateSensor.takeForcedMeasurement();
    int temp=climateSensor.getTemperatureCelcius()/100;
    int hum=climateSensor.getRelativeHumidity()/100;
    int pres=climateSensor.getPressure()/100;
    
    oled.setFont(currentFont1);
    if (Page == 1) {
      oled.setCursor(25, 3);
      oled.print("Temp");
      oled.setCursor(25, 5);
      oled.print("      ");
      oled.setCursor(25, 5);
      oled.print(temp);
      oled.setCursor(90, 3);
      oled.print("Hum");
      oled.setCursor(90, 5);
      oled.print("      ");
      oled.setCursor(90, 5);
      oled.print(hum);
    } else {
      oled.setCursor(25, 3);
      oled.print("Pres");
      oled.setCursor(25, 5);
      oled.print("          ");
      oled.setCursor(25, 5);
      oled.print(pres);
    }
    previousTime = currentTime;
  }
}

void Characters()
{
  oled.bitmap(5, 1, 49, 8, TheKnight);
  oled.setFont(currentFont);
  oled.setCursor(60, 1);
  oled.print("Character:");
  oled.setCursor(60, 2);
  oled.print("The Knight");
  oled.setCursor(60, 4);
  oled.print("Weapon:");
  oled.setCursor(60, 5);
  oled.print("Nail");  
}

void setup() {
  pinMode(BUTTON_R_PIN, INPUT_PULLUP); // up button, set to INPUT_PULLUP = when not pressed, pin is HIGH
  pinMode(BUTTON_L_PIN, INPUT_PULLUP); // down button, set to INPUT_PULLUP = when not pressed, pin is HIGH
  pinMode(BUTTON_SELECT_PIN, INPUT_PULLUP);
  // put your setup code here, to run once:
  oled.begin(128, 64, sizeof(tiny4koled_init_128x64), tiny4koled_init_128x64); // display initialization
  oled.enableChargePump();  // The default is off, but most boards need this.
  oled.setRotation(1);     // The default orientation is not the most commonly used.
  oled.clear();  // clear the screen
  oled.on(); // turn on the display
  climateSensor.begin();
}

void loop() {
  if(digitalRead(BUTTON_SELECT_PIN)==LOW)
  {
    Mode=abs(Mode-1);
    Page=1;
    oled.clear();
    delay(100);
  }

  if(digitalRead(BUTTON_R_PIN)==LOW)
  {
    Page++;
    oled.clear();
    delay(100);
  }
    
  if(digitalRead(BUTTON_L_PIN)==LOW)
  {
    Page--;
    oled.clear();
    delay(100);
  }

  if(Mode==0)
  {
    if(Page>2)
    Page=1;
    if(Page<1)
    Page=2;
    Sensor();
  }
   
    else
  {
    if(Page>4)
    Page=1;
    if(Page<1)
    Page=4;
    Characters();
  }
}
